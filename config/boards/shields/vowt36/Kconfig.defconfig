## config/boards/shields/vowt36/Kconfig.defconfig
```kconfig
if SHIELD_VOWT36_DONGLE

config ZMK_KEYBOARD_NAME
	default "Vowt36 Dongle"
	
config ZMK_SPLIT_BLE_ROLE_CENTRAL
	default y
	
config ZMK_USB
	default y

if ZMK_DISPLAY

config I2C
    default y

config SSD1306
    default y

choice ZMK_DISPLAY_WORK_QUEUE
    default ZMK_DISPLAY_WORK_QUEUE_DEDICATED
endchoice

if LVGL

config LV_Z_VDB_SIZE
    default 64

config LV_DPI_DEF
    default 148

config LV_Z_BITS_PER_PIXEL
    default 1

choice LV_COLOR_DEPTH
    default LV_COLOR_DEPTH_1
endchoice

endif # LVGL

endif # ZMK_DISPLAY

endif #SHIELD_VOWT36_DONGLE

if SHIELD_VOWT36_LEFT || SHIELD_VOWT36_RIGHT || SHIELD_VOWT36_DONGLE 

config ZMK_SPLIT
	default y

config ZMK_BLE
	default y
	
endif #SHIELD_VOWT36_LEFT || SHIELD_VOWT36_RIGHT || SHIELD_VOWT36_DONGLE 


# Battery reporting
# CONFIG_ZMK_SPLIT_BLE_CENTRAL_BATTERY_LEVEL_FETCHING=y
# CONFIG_ZMK_SPLIT_BLE_CENTRAL_BATTERY_LEVEL_PROXY=y
```

## config/boards/shields/vowt36/Kconfig.shield
```kconfig
# No whitespace after the comma or in the keyboard name!
config SHIELD_VOWT36_DONGLE
    def_bool $(shields_list_contains,vowt36_dongle)

config SHIELD_VOWT36_LEFT
    def_bool $(shields_list_contains,vowt36_left)
    
config SHIELD_VOWT36_RIGHT
    def_bool $(shields_list_contains,vowt36_right)
```
